## CMakeLists.txt
```
#
# Copyright (c) 2021 Nordic Semiconductor ASA
#
# SPDX-License-Identifier: LicenseRef-Nordic-5-Clause
#

cmake_minimum_required(VERSION 3.20.0)

list(APPEND BOARD_ROOT ${CMAKE_CURRENT_SOURCE_DIR})

find_package(Zephyr HINTS $ENV{ZEPHYR_BASE})

project(micro_matter_button)

# Enable GNU STD support.
include(${ZEPHYR_CONNECTEDHOMEIP_MODULE_DIR}/config/nrfconnect/app/enable-gnu-std.cmake)

# NORDIC SDK APP START

# Include all source files that are located in the Matter common directory.
include(${ZEPHYR_NRF_MODULE_DIR}/samples/matter/common/cmake/source_common.cmake)

# Include Data Model utils
include(${ZEPHYR_NRF_MODULE_DIR}/samples/matter/common/cmake/data_model.cmake)

include(${ZEPHYR_NRF_MODULE_DIR}/samples/matter/common/cmake/zap_helpers.cmake)
ncs_get_zap_parent_dir(ZAP_PARENT_DIR)

target_include_directories(app PRIVATE
  src
  ${ZAP_PARENT_DIR}
)

target_compile_options(app PRIVATE -Wno-deprecated-declarations)

target_sources(app PRIVATE
  src/app_task.cpp
  src/light_switch.cpp
  src/rotary_dimmer.cpp
  src/main.cpp
  src/shell_commands.cpp
  ${ZEPHYR_NRF_MODULE_DIR}/samples/matter/common/src/binding/binding_handler.cpp
)

ncs_configure_data_model()
# NORDIC SDK APP END
```

## prj.conf
```kconfig
#
# Copyright (c) 2021 Nordic Semiconductor ASA
#
# SPDX-License-Identifier: LicenseRef-Nordic-5-Clause
#

# Enable CHIP
CONFIG_CHIP=y
CONFIG_CHIP_PROJECT_CONFIG="src/chip_project_config.h"
CONFIG_CHIP_DEVICE_PRODUCT_NAME="Matter Light Switch"

# Configure ZAP file name
CONFIG_NCS_SAMPLE_MATTER_ZAP_FILE_PATH="${APPLICATION_CONFIG_DIR}/src/default_zap/light_switch.zap"

# 32772 == 0x8004 (example light-switch-app)
CONFIG_CHIP_DEVICE_PRODUCT_ID=32772
CONFIG_STD_CPP17=y

# Enable Matter pairing automatically on application start.
CONFIG_CHIP_ENABLE_PAIRING_AUTOSTART=y

# Enable Matter extended announcement and increase duration to 1 hour.
CONFIG_CHIP_BLE_EXT_ADVERTISING=y
CONFIG_CHIP_BLE_ADVERTISING_DURATION=60

# Add support for LEDs and buttons on Nordic development kits
CONFIG_DK_LIBRARY=y

# Try to disable unused RAM blocks to reduce power consumption
CONFIG_RAM_POWER_DOWN_LIBRARY=y

# Bluetooth Low Energy configuration
CONFIG_BT_DEVICE_NAME="MatterSwitch"

# Suspend devices when the CPU goes into sleep
CONFIG_PM_DEVICE=y

# Enable system reset on fatal error
CONFIG_RESET_ON_FATAL_ERROR=y

# Disable all debug features
CONFIG_USE_SEGGER_RTT=n
CONFIG_SHELL=n
CONFIG_OPENTHREAD_SHELL=n
CONFIG_CONSOLE=n
CONFIG_UART_CONSOLE=n
CONFIG_SERIAL=n
CONFIG_LOG=n
CONFIG_LOG_MODE_MINIMAL=n
CONFIG_ASSERT_VERBOSE=n
CONFIG_ASSERT_NO_FILE_INFO=y
CONFIG_PRINTK=n
CONFIG_PRINTK_SYNC=n
CONFIG_THREAD_NAME=n
CONFIG_BOOT_BANNER=n

# Enable Factory Data feature
CONFIG_CHIP_FACTORY_DATA=y
CONFIG_CHIP_FACTORY_DATA_BUILD=y

# Enable Watchdog
CONFIG_NCS_SAMPLE_MATTER_WATCHDOG=y

# Enable LTO to decrease the flash usage.
CONFIG_LTO=y
CONFIG_ISR_TABLES_LOCAL_DECLARATION=y

# Enable Factory Data feature
CONFIG_CHIP_FACTORY_DATA=n
CONFIG_CHIP_FACTORY_DATA_BUILD=n

CONFIG_CHIP_OTA_REQUESTOR=n
CONFIG_BOOTLOADER_MCUBOOT=n
CONFIG_CHIP_BOOTLOADER_MCUBOOT=n
CONFIG_CHIP_BOOTLOADER_NONE=y

CONFIG_CHIP_NFC_ONBOARDING_PAYLOAD=n


# Persistent Subscriptions
CONFIG_CHIP_PERSISTENT_SUBSCRIPTIONS=y

# Switch off LEDS
CONFIG_NCS_SAMPLE_MATTER_LEDS=n

# Configure Power Management
CONFIG_PM_DEVICE=y
CONFIG_RAM_POWER_DOWN_LIBRARY=y
CONFIG_POWEROFF=y

# Settings for ICD with LIT
CONFIG_OPENTHREAD_MTD=y
CONFIG_OPENTHREAD_NORDIC_LIBRARY_MTD=y

CONFIG_CHIP_ENABLE_ICD_SUPPORT=y
CONFIG_CHIP_ICD_LIT_SUPPORT=y

CONFIG_CHIP_ICD_IDLE_MODE_DURATION=900
CONFIG_CHIP_ICD_SLOW_POLL_INTERVAL=300000
CONFIG_CHIP_ICD_ACTIVE_MODE_DURATION=500
CONFIG_CHIP_ICD_ACTIVE_MODE_THRESHOLD=10000
CONFIG_CHIP_ICD_FAST_POLLING_INTERVAL=1000

CONFIG_CHIP_ICD_CLIENTS_PER_FABRIC=2

CONFIG_SPI=y
CONFIG_SENSOR=y
CONFIG_LIS2DH=y
CONFIG_LIS2DH_TRIGGER_NONE=y
```

## prj_debug.conf
```kconfig
#
# Copyright (c) 2021 Nordic Semiconductor ASA
#
# SPDX-License-Identifier: LicenseRef-Nordic-5-Clause
#

# Enable CHIP
CONFIG_CHIP=y
CONFIG_CHIP_PROJECT_CONFIG="src/chip_project_config.h"
CONFIG_CHIP_DEVICE_PRODUCT_NAME="Matter Light Switch"

# Configure ZAP file name
CONFIG_NCS_SAMPLE_MATTER_ZAP_FILE_PATH="${APPLICATION_CONFIG_DIR}/src/default_zap/light_switch.zap"

# 32772 == 0x8004 (example light-switch-app)
CONFIG_CHIP_DEVICE_PRODUCT_ID=32772
CONFIG_STD_CPP17=y

# Enable Matter pairing automatically on application start.
CONFIG_CHIP_ENABLE_PAIRING_AUTOSTART=y

# Enable Matter extended announcement and increase duration to 1 hour.
CONFIG_CHIP_BLE_EXT_ADVERTISING=y
CONFIG_CHIP_BLE_ADVERTISING_DURATION=60

# Add support for LEDs and buttons on Nordic development kits
CONFIG_DK_LIBRARY=y

# Bluetooth Low Energy configuration
CONFIG_BT_DEVICE_NAME="MatterSwitch"

# Suspend devices when the CPU goes into sleep
CONFIG_PM_DEVICE=y

# Other settings
CONFIG_THREAD_NAME=y
CONFIG_MPU_STACK_GUARD=y
CONFIG_RESET_ON_FATAL_ERROR=n
CONFIG_CHIP_LIB_SHELL=y
CONFIG_NCS_SAMPLE_MATTER_TEST_SHELL=y

# Reduce application size
CONFIG_USE_SEGGER_RTT=n

# Enable Factory Data feature
CONFIG_CHIP_FACTORY_DATA=n
CONFIG_CHIP_FACTORY_DATA_BUILD=n

CONFIG_CHIP_OTA_REQUESTOR=n
CONFIG_BOOTLOADER_MCUBOOT=n
CONFIG_CHIP_BOOTLOADER_MCUBOOT=n
CONFIG_CHIP_BOOTLOADER_NONE=y

CONFIG_CHIP_NFC_ONBOARDING_PAYLOAD=n

# Persistent Subscriptions
CONFIG_CHIP_PERSISTENT_SUBSCRIPTIONS=y

CONFIG_SPI=y
CONFIG_SENSOR=y
CONFIG_LIS2DH=y
CONFIG_LIS2DH_TRIGGER_NONE=y
```

## src/app_task.h
```c
/*
 * Copyright (c) 2022 Nordic Semiconductor ASA
 *
 * SPDX-License-Identifier: LicenseRef-Nordic-5-Clause
 */

#pragma once

#include "board/board.h"
#include "rotary_dimmer.h"

#include <platform/CHIPDeviceLayer.h>
#include <zephyr/drivers/sensor.h>

struct k_timer;
struct Identify;

class AppTask {
public:
	static AppTask &Instance()
	{
		static AppTask sAppTask;
		return sAppTask;
	};

	CHIP_ERROR StartApp();

	void UpdateClusterState();
	static void UpdateStatusLed();

private:
	enum Timer : uint8_t {
		/* Accelerometer rotational dimming */
		SingleTap,
		AccelPoll,
		AccelSleep,
		/* GPIO long-press dimming */
		DimmerTrigger,
		Dimmer,
		/* Generic switch long-press */
		LongPressDetect,
		/* All modes: factory reset */
		FactoryWarning,
		FactoryReset,
		/* All modes: commissioning LED */
		StatusLedBlink,
		/* 25015 only: environmental sensor poll */
		SensorPoll,
	};

	CHIP_ERROR Init();

	static void TimerEventHandler(const Timer &event);
	static void ButtonEventHandler(Nrf::ButtonState state, Nrf::ButtonMask hasChanged);

	static void EnterAccelIdleMode();
	static void StartAccelDimming();
	static void EmitRotationStep(const RotaryUpdate &update);
	static void AccelPollEventHandler();
	static void SensorUpdateEventHandler();

	static void StartTimer(Timer, uint32_t);
	static void CancelTimer(Timer);
	static void UserTimerTimeoutCallback(k_timer *timer);

	static void MatterEventHandler(const chip::DeviceLayer::ChipDeviceEvent *event, intptr_t arg);
};
```

## src/light_switch.cpp
```c
/*
 * Copyright (c) 2022 Nordic Semiconductor ASA
 *
 * SPDX-License-Identifier: LicenseRef-Nordic-5-Clause
 */

#include "light_switch.h"
#include "binding/binding_handler.h"

#ifdef CONFIG_CHIP_LIB_SHELL
#include "shell_commands.h"
#endif

#include <app/clusters/bindings/binding-table.h>
#include <app/server/Server.h>
#include <controller/InvokeInteraction.h>
#include <platform/CHIPDeviceLayer.h>
#include <zephyr/logging/log.h>
#include <algorithm>
#include <cstdlib>

using namespace chip;
using namespace chip::app;
using namespace chip::app::Clusters;

namespace {
constexpr uint8_t kOnePercentBrightnessApproximation = 3;
constexpr uint8_t kMaximumBrightness = 254;
} // namespace

LOG_MODULE_DECLARE(app, CONFIG_CHIP_APP_LOG_LEVEL);

void LightSwitch::Init(chip::EndpointId lightSwitchEndpoint)
{
	Nrf::Matter::BindingHandler::Init();
#ifdef CONFIG_CHIP_LIB_SHELL
	SwitchCommands::RegisterSwitchCommands();
#endif
	mLightSwitchEndpoint = lightSwitchEndpoint;
}

void LightSwitch::InitiateActionSwitch(Action action)
{
	Nrf::Matter::BindingHandler::BindingData *data = Platform::New<Nrf::Matter::BindingHandler::BindingData>();
	if (data) {
		data->EndpointId = mLightSwitchEndpoint;
		data->ClusterId = Clusters::OnOff::Id;
		data->InvokeCommandFunc = SwitchChangedHandler;
		switch (action) {
		case Action::Toggle:
			data->CommandId = Clusters::OnOff::Commands::Toggle::Id;
			break;
		case Action::On:
			data->CommandId = Clusters::OnOff::Commands::On::Id;
			break;
		case Action::Off:
			data->CommandId = Clusters::OnOff::Commands::Off::Id;
			break;
		default:
			Platform::Delete(data);
			return;
		}
		Nrf::Matter::BindingHandler::RunBoundClusterAction(data);
	}
}

// UPDATED: Simply passes the requested level to the Thread network
void LightSwitch::SetBrightnessLevel(uint8_t targetLevel)
{
	Nrf::Matter::BindingHandler::BindingData *data = Platform::New<Nrf::Matter::BindingHandler::BindingData>();
	if (data) {
		data->EndpointId = mLightSwitchEndpoint;
		data->CommandId = Clusters::LevelControl::Commands::MoveToLevelWithOnOff::Id;
		data->ClusterId = Clusters::LevelControl::Id;
		data->InvokeCommandFunc = SwitchChangedHandler;
		
		data->Value = targetLevel;
		
		Nrf::Matter::BindingHandler::RunBoundClusterAction(data);
	}
}

void LightSwitch::StepBrightness(int16_t stepDelta)
{
	if (stepDelta == 0) {
		return;
	}
	Nrf::Matter::BindingHandler::BindingData *data = Platform::New<Nrf::Matter::BindingHandler::BindingData>();
	if (data) {
		data->EndpointId = mLightSwitchEndpoint;
		data->CommandId = Clusters::LevelControl::Commands::StepWithOnOff::Id;
		data->ClusterId = Clusters::LevelControl::Id;
		data->InvokeCommandFunc = SwitchChangedHandler;

		uint8_t magnitude = static_cast<uint8_t>(std::min<int16_t>(std::abs(stepDelta), 127));
		data->Value = (stepDelta < 0) ? static_cast<uint8_t>(magnitude | 0x80) : magnitude;

		Nrf::Matter::BindingHandler::RunBoundClusterAction(data);
	}
}

void LightSwitch::DimmerChangeBrightness()
{
	static uint16_t sBrightness = 0;
	Nrf::Matter::BindingHandler::BindingData *data = Platform::New<Nrf::Matter::BindingHandler::BindingData>();
	if (data) {
		data->EndpointId = mLightSwitchEndpoint;
		data->CommandId = Clusters::LevelControl::Commands::MoveToLevel::Id;
		data->ClusterId = Clusters::LevelControl::Id;
		data->InvokeCommandFunc = SwitchChangedHandler;
		sBrightness += kOnePercentBrightnessApproximation;
		if (sBrightness > kMaximumBrightness) {
			sBrightness = 0;
		}
		data->Value = (uint8_t)sBrightness;
		Nrf::Matter::BindingHandler::RunBoundClusterAction(data);
	}
}

void LightSwitch::SwitchChangedHandler(const Binding::TableEntry &binding, OperationalDeviceProxy *deviceProxy,
				       Nrf::Matter::BindingHandler::BindingData &bindingData)
{
	if (binding.type == Binding::MATTER_MULTICAST_BINDING) {
		switch (bindingData.ClusterId) {
		case Clusters::OnOff::Id:
			OnOffProcessCommand(bindingData.CommandId, binding, nullptr, bindingData);
			break;
		case Clusters::LevelControl::Id:
			LevelControlProcessCommand(bindingData.CommandId, binding, nullptr, bindingData);
			break;
		default:
			ChipLogError(NotSpecified, "Invalid binding group command data");
			break;
		}
	} else if (binding.type == Binding::MATTER_UNICAST_BINDING) {
		switch (bindingData.ClusterId) {
		case Clusters::OnOff::Id:
			OnOffProcessCommand(bindingData.CommandId, binding, deviceProxy, bindingData);
			break;
		case Clusters::LevelControl::Id:
			LevelControlProcessCommand(bindingData.CommandId, binding, deviceProxy, bindingData);
			break;
		default:
			ChipLogError(NotSpecified, "Invalid binding unicast command data");
			break;
		}
	}
}

void LightSwitch::OnOffProcessCommand(CommandId commandId, const Binding::TableEntry &binding,
				      OperationalDeviceProxy *device,
				      Nrf::Matter::BindingHandler::BindingData &bindingData)
{
	CHIP_ERROR ret = CHIP_NO_ERROR;

	auto onSuccess = [dataPointer = Platform::New<Nrf::Matter::BindingHandler::BindingData>(bindingData)](
				 const ConcreteCommandPath &commandPath, const StatusIB &status,
				 const auto &dataResponse) {
		Nrf::Matter::BindingHandler::OnInvokeCommandSucces(dataPointer);
	};

	auto onFailure = [dataPointer = Platform::New<Nrf::Matter::BindingHandler::BindingData>(bindingData)](
				 CHIP_ERROR aError) mutable {
		Nrf::Matter::BindingHandler::OnInvokeCommandFailure(dataPointer, aError);
	};

	if (device) {
		VerifyOrDie(device->ConnectionReady());
	}

	switch (commandId) {
	case Clusters::OnOff::Commands::Toggle::Id:
		Clusters::OnOff::Commands::Toggle::Type toggleCommand;
		if (device) {
			ret = Controller::InvokeCommandRequest(device->GetExchangeManager(),
							       device->GetSecureSession().Value(), binding.remote,
							       toggleCommand, onSuccess, onFailure);
		} else {
			Messaging::ExchangeManager &exchangeMgr = Server::GetInstance().GetExchangeManager();
			ret = Controller::InvokeGroupCommandRequest(&exchangeMgr, binding.fabricIndex, binding.groupId,
								    toggleCommand);
		}
		break;

	case Clusters::OnOff::Commands::On::Id:
		Clusters::OnOff::Commands::On::Type onCommand;
		if (device) {
			ret = Controller::InvokeCommandRequest(device->GetExchangeManager(),
							       device->GetSecureSession().Value(), binding.remote,
							       onCommand, onSuccess, onFailure);
		} else {
			Messaging::ExchangeManager &exchangeMgr = Server::GetInstance().GetExchangeManager();
			ret = Controller::InvokeGroupCommandRequest(&exchangeMgr, binding.fabricIndex, binding.groupId,
								    onCommand);
		}
		break;

	case Clusters::OnOff::Commands::Off::Id:
		Clusters::OnOff::Commands::Off::Type offCommand;
		if (device) {
			ret = Controller::InvokeCommandRequest(device->GetExchangeManager(),
							       device->GetSecureSession().Value(), binding.remote,
							       offCommand, onSuccess, onFailure);
		} else {
			Messaging::ExchangeManager &exchangeMgr = Server::GetInstance().GetExchangeManager();
			ret = Controller::InvokeGroupCommandRequest(&exchangeMgr, binding.fabricIndex, binding.groupId,
								    offCommand);
		}
		break;
	default:
		LOG_DBG("Invalid binding command data - commandId is not supported");
		break;
	}
	if (CHIP_NO_ERROR != ret) {
		LOG_ERR("Invoke OnOff Command Request ERROR: %s", ErrorStr(ret));
	}
}

void LightSwitch::LevelControlProcessCommand(CommandId commandId, const Binding::TableEntry &binding,
					     OperationalDeviceProxy *device,
					     Nrf::Matter::BindingHandler::BindingData &bindingData)
{
	auto onSuccess = [dataPointer = Platform::New<Nrf::Matter::BindingHandler::BindingData>(bindingData)](
				 const ConcreteCommandPath &commandPath, const StatusIB &status,
				 const auto &dataResponse) {
		Nrf::Matter::BindingHandler::OnInvokeCommandSucces(dataPointer);
	};

	auto onFailure = [dataPointer = Platform::New<Nrf::Matter::BindingHandler::BindingData>(bindingData)](
				 CHIP_ERROR aError) mutable {
		Nrf::Matter::BindingHandler::OnInvokeCommandFailure(dataPointer, aError);
	};

	CHIP_ERROR ret = CHIP_NO_ERROR;

	if (device) {
		VerifyOrDie(device->ConnectionReady());
	}

	switch (commandId) {
	case Clusters::LevelControl::Commands::MoveToLevelWithOnOff::Id: {
		Clusters::LevelControl::Commands::MoveToLevelWithOnOff::Type moveToLevelCommand;
		
		moveToLevelCommand.level = bindingData.Value;
		
        // THE FIX: Change 0 to 4 (400 milliseconds) for a smooth premium fade
		moveToLevelCommand.transitionTime.SetNonNull(4); 

		if (device) {
			ret = Controller::InvokeCommandRequest(device->GetExchangeManager(),
							       device->GetSecureSession().Value(), binding.remote,
							       moveToLevelCommand, onSuccess, onFailure);
		} else {
			Messaging::ExchangeManager &exchangeMgr = Server::GetInstance().GetExchangeManager();
			ret = Controller::InvokeGroupCommandRequest(&exchangeMgr, binding.fabricIndex, binding.groupId,
								    moveToLevelCommand);
		}
	} break;
	case Clusters::LevelControl::Commands::StepWithOnOff::Id: {
		Clusters::LevelControl::Commands::StepWithOnOff::Type stepCommand;
		bool stepDown = (bindingData.Value & 0x80) != 0;
		stepCommand.stepMode = stepDown ? Clusters::LevelControl::StepModeEnum::kDown
						: Clusters::LevelControl::StepModeEnum::kUp;
		stepCommand.stepSize = static_cast<uint8_t>(bindingData.Value & 0x7F);
		stepCommand.transitionTime.SetNonNull(2);

		if (device) {
			ret = Controller::InvokeCommandRequest(device->GetExchangeManager(),
							       device->GetSecureSession().Value(), binding.remote,
							       stepCommand, onSuccess, onFailure);
		} else {
			Messaging::ExchangeManager &exchangeMgr = Server::GetInstance().GetExchangeManager();
			ret = Controller::InvokeGroupCommandRequest(&exchangeMgr, binding.fabricIndex, binding.groupId,
								    stepCommand);
		}
	} break;
	default:
		LOG_DBG("Invalid binding command data - commandId is not supported");
		break;
	}
	if (CHIP_NO_ERROR != ret) {
		LOG_ERR("Invoke Group Command Request ERROR: %s", ErrorStr(ret));
	}
}
```

## src/light_switch.h
```c
/*
 * Copyright (c) 2022 Nordic Semiconductor ASA
 *
 * SPDX-License-Identifier: LicenseRef-Nordic-5-Clause
 */

#pragma once
#include <app/util/basic-types.h>
#include <lib/core/CHIPError.h>

#include "binding/binding_handler.h"

#include <atomic>

class LightSwitch {
public:
	enum class Action : uint8_t {
		Toggle,
		On,
		Off 
	};

	void Init(chip::EndpointId lightSwitchEndpoint);
	void InitiateActionSwitch(Action action);
	void SetBrightnessLevel(uint8_t targetLevel);
	void StepBrightness(int16_t stepDelta);
	void DimmerChangeBrightness();
	
	chip::EndpointId GetLightSwitchEndpointId() { return mLightSwitchEndpoint; }
	static void SwitchChangedHandler(const chip::app::Clusters::Binding::TableEntry &binding,
					 chip::OperationalDeviceProxy *deviceProxy,
					 Nrf::Matter::BindingHandler::BindingData &bindingData);

	static LightSwitch &GetInstance()
	{
		static LightSwitch sLightSwitch;
		return sLightSwitch;
	}

private:
	static void OnOffProcessCommand(chip::CommandId commandId,
					const chip::app::Clusters::Binding::TableEntry &binding,
					chip::OperationalDeviceProxy *device,
					Nrf::Matter::BindingHandler::BindingData &bindingData);
	static void LevelControlProcessCommand(chip::CommandId commandId,
					       const chip::app::Clusters::Binding::TableEntry &binding,
					       chip::OperationalDeviceProxy *device,
					       Nrf::Matter::BindingHandler::BindingData &bindingData);

	chip::EndpointId mLightSwitchEndpoint;
};
```

## src/rotary_dimmer.cpp
```c
/*
 * Copyright (c) 2026 Nordic Semiconductor ASA
 *
 * SPDX-License-Identifier: LicenseRef-Nordic-5-Clause
 */

#include "rotary_dimmer.h"

#include <algorithm>
#include <cmath>
#include <cstdlib>

void RotaryDimmer::ResetOnWake()
{
	mFirstSampleAfterWake = true;
	mPendingAngleDelta = 0.0;
	mSwipeArmed = true;
}

double RotaryDimmer::NormalizeAngle(double angleRad)
{
	while (angleRad > kPi) {
		angleRad -= 2.0 * kPi;
	}
	while (angleRad <= -kPi) {
		angleRad += 2.0 * kPi;
	}
	return angleRad;
}

void RotaryDimmer::FlushPendingDelta(uint32_t nowMs, RotaryUpdate &outUpdate)
{
	double rawLevelDelta = mPendingAngleDelta * kRotationToLevelMultiplier;
	int16_t stepLevel = static_cast<int16_t>(std::round(rawLevelDelta));
	if (stepLevel == 0) {
		stepLevel = (mPendingAngleDelta > 0.0) ? 1 : -1;
	}
	stepLevel = std::clamp<int16_t>(stepLevel, -254, 254);

	double rawPercentDelta = (static_cast<double>(stepLevel) * 100.0) / 254.0;
	int8_t stepPercent = static_cast<int8_t>(std::round(rawPercentDelta));
	if (stepPercent == 0) {
		stepPercent = (stepLevel > 0) ? 1 : -1;
	}
	stepPercent = std::clamp<int8_t>(stepPercent, -100, 100);

	uint8_t magnitudePct = static_cast<uint8_t>(std::clamp<int>(std::abs(stepPercent), 1, 100));
	uint8_t offset = (mControlMode == RotaryControlMode::ColorTemp) ? kColorTempPositionOffset : 0U;

	outUpdate.hasStep = true;
	outUpdate.mode = mControlMode;
	outUpdate.stepLevel = stepLevel;
	outUpdate.stepPercent = stepPercent;
	outUpdate.encodedPosition = static_cast<uint8_t>(magnitudePct + offset);
	outUpdate.targetLevel = static_cast<uint8_t>(std::round(mAccumulatedBrightness));

	mPendingAngleDelta = 0.0;
	mLastSendTimeMs = nowMs;
}

RotaryUpdate RotaryDimmer::ProcessSample(double x, double y, double z, uint32_t nowMs)
{
	RotaryUpdate update;
	update.mode = mControlMode;
	update.targetLevel = static_cast<uint8_t>(std::round(mAccumulatedBrightness));

	double totalNorm = std::sqrt((x * x) + (y * y) + (z * z));
	double currentAngle = std::atan2(y, x);

	if (mFirstSampleAfterWake) {
		mLastAngle = currentAngle;
		mFirstSampleAfterWake = false;
		mPendingAngleDelta = 0.0;
		mLastMovementTimeMs = nowMs;
		mLastSendTimeMs = nowMs;
		if (totalNorm >= 7.0 && totalNorm <= 12.5) {
			mGravityX = x;
			mGravityY = y;
			mGravityZ = z;
			return update;
		}
	}

	/* Decompose 3D linear acceleration relative to the tracked upward gravity vector */
	double gNorm = std::sqrt((mGravityX * mGravityX) + (mGravityY * mGravityY) + (mGravityZ * mGravityZ));
	double linX = x - mGravityX;
	double linY = y - mGravityY;
	double linZ = z - mGravityZ;
	double aVert = 0.0;
	double aHoriz = 0.0;

	if (gNorm >= 3.0) {
		double ux = mGravityX / gNorm;
		double uy = mGravityY / gNorm;
		double uz = mGravityZ / gNorm;
		aVert = (linX * ux) + (linY * uy) + (linZ * uz);
		double hx = linX - (aVert * ux);
		double hy = linY - (aVert * uy);
		double hz = linZ - (aVert * uz);
		aHoriz = std::sqrt((hx * hx) + (hy * hy) + (hz * hz));
	}

	bool hasLinearImpulse = (totalNorm >= 2.8) && (std::abs(totalNorm - kStandardGravity) >= 0.8);

	/* Check for 3D linear swipe gesture (Up, Down, or Horizontal) when linear impulse is present */
	if (hasLinearImpulse && nowMs >= mSwipeCooldownUntilMs && mSwipeArmed) {
		if (std::abs(aVert) >= kSwipeAccelThreshold && std::abs(aVert) >= aHoriz) {
			update.swipe = (aVert > 0.0) ? SwipeGesture::Up : SwipeGesture::Down;
			update.encodedPosition =
				(aVert > 0.0) ? kShutterUpPosition : kShutterDownPosition;
		} else if (aHoriz >= kSwipeAccelThreshold && aHoriz > std::abs(aVert)) {
			update.swipe = SwipeGesture::Horizontal;
			update.encodedPosition = kShutterStopPosition;
		}

		if (update.swipe != SwipeGesture::None) {
			update.movementDetected = true;
			mSwipeCooldownUntilMs = nowMs + kSwipeCooldownMs;
			mSwipeArmed = false;
			mPendingAngleDelta = 0.0;
			mLastAngle = currentAngle;
			mLastMovementTimeMs = nowMs;
			return update;
		}
	}

	/* Update gravity vector when in 1g condition (no linear acceleration) */
	if (!hasLinearImpulse) {
		mGravityX = x;
		mGravityY = y;
		mGravityZ = z;
		if (nowMs >= mSwipeCooldownUntilMs) {
			mSwipeArmed = true;
		}
	} else if (std::abs(totalNorm - kStandardGravity) < kLinearRestThreshold) {
		constexpr double kAlpha = 0.25;
		mGravityX = ((1.0 - kAlpha) * mGravityX) + (kAlpha * x);
		mGravityY = ((1.0 - kAlpha) * mGravityY) + (kAlpha * y);
		mGravityZ = ((1.0 - kAlpha) * mGravityZ) + (kAlpha * z);
		if (nowMs >= mSwipeCooldownUntilMs) {
			mSwipeArmed = true;
		}
	}

	/* Suppress rotary dimming while in swipe cooldown or experiencing linear acceleration */
	if (nowMs < mSwipeCooldownUntilMs || std::abs(totalNorm - kStandardGravity) >= 2.5) {
		mLastAngle = currentAngle;
		mPendingAngleDelta = 0.0;
		return update;
	}

	if (std::abs(z) > kHorizontalZLimit) {
		if (std::abs(mPendingAngleDelta) >= kSettleStepAngleRad) {
			FlushPendingDelta(nowMs, update);
		}
		update.stopDimming = true;
		return update;
	}

	double magnitudeSq = (x * x) + (y * y);
	if (magnitudeSq < kMinXYMagnitudeSq) {
		mLastAngle = currentAngle;
		mLastMovementTimeMs = nowMs;
		return update;
	}

	double deltaAngle = NormalizeAngle(currentAngle - mLastAngle);

	if (std::abs(deltaAngle) >= kNoiseDeadbandRad) {
		mLastAngle = currentAngle;
		mLastMovementTimeMs = nowMs;
		mPendingAngleDelta += deltaAngle;
		if (mControlMode == RotaryControlMode::Brightness) {
			mAccumulatedBrightness = std::clamp(
				mAccumulatedBrightness + (deltaAngle * kRotationToLevelMultiplier), 1.0, 254.0);
		}
		update.targetLevel = static_cast<uint8_t>(std::round(mAccumulatedBrightness));
		update.movementDetected = true;

		if ((nowMs - mLastSendTimeMs) >= kLiveSendIntervalMs &&
		    std::abs(mPendingAngleDelta) >= kLiveStepAngleRad) {
			FlushPendingDelta(nowMs, update);
		}
	} else {
		if ((nowMs - mLastMovementTimeMs) >= kSettlingTimeMs &&
		    std::abs(mPendingAngleDelta) >= kSettleStepAngleRad) {
			FlushPendingDelta(nowMs, update);
		}
	}

	return update;
}

extern "C" {

/**
 * @brief C-ABI wrapper to allocate a RotaryDimmer instance for unit testing.
 */
RotaryDimmer *rotary_dimmer_create()
{
	return new RotaryDimmer();
}

/**
 * @brief C-ABI wrapper to destroy a RotaryDimmer instance.
 */
void rotary_dimmer_destroy(RotaryDimmer *dimmer)
{
	delete dimmer;
}

/**
 * @brief C-ABI wrapper to reset a RotaryDimmer instance on wake.
 */
void rotary_dimmer_reset(RotaryDimmer *dimmer)
{
	if (dimmer) {
		dimmer->ResetOnWake();
	}
}

/**
 * @brief C-ABI wrapper to set the control mode (0 = Brightness, 1 = ColorTemp).
 */
void rotary_dimmer_set_mode(RotaryDimmer *dimmer, uint8_t mode)
{
	if (dimmer) {
		dimmer->SetControlMode(
			mode == 1 ? RotaryControlMode::ColorTemp : RotaryControlMode::Brightness);
	}
}

/**
 * @brief C-ABI wrapper to process a sample and populate a RotaryUpdate struct.
 */
RotaryUpdate rotary_dimmer_process(RotaryDimmer *dimmer, double x, double y, double z, uint32_t nowMs)
{
	if (!dimmer) {
		return RotaryUpdate{};
	}
	return dimmer->ProcessSample(x, y, z, nowMs);
}

} /* extern "C" */
```

## src/rotary_dimmer.h
```c
/*
 * Copyright (c) 2026 Nordic Semiconductor ASA
 *
 * SPDX-License-Identifier: LicenseRef-Nordic-5-Clause
 */

#pragma once

#include <cstdint>

/**
 * @brief Operating mode for rotational control.
 */
enum class RotaryControlMode : uint8_t {
	/** Default mode: turning adjusts light brightness (positions 1..100). */
	Brightness = 0,
	/** Double-click mode: turning adjusts light color temperature (positions 101..200). */
	ColorTemp = 1,
};

/**
 * @brief Linear 3D swipe gesture for roller shutter control when removed from the wall.
 */
enum class SwipeGesture : uint8_t {
	None = 0,
	/** Vertical upward swipe -> Open / raise roller shutters (position 201). */
	Up = 1,
	/** Vertical downward swipe -> Close / lower roller shutters (position 202). */
	Down = 2,
	/** Horizontal swipe in any direction -> Stop roller shutters (position 203). */
	Horizontal = 3,
};

/**
 * @brief Result of processing a single 3-axis accelerometer sample.
 */
struct RotaryUpdate {
	/** True if a rotary step should be transmitted immediately. */
	bool hasStep = false;
	/** True if the board was tilted flat/horizontally and rotary dimming is paused. */
	bool stopDimming = false;
	/** True if rotational or linear movement above the noise floor was detected. */
	bool movementDetected = false;
	/** Active rotary control mode (Brightness or ColorTemp). */
	RotaryControlMode mode = RotaryControlMode::Brightness;
	/** Detected linear swipe gesture (None, Up, Down, or Horizontal). */
	SwipeGesture swipe = SwipeGesture::None;
	/** Signed relative rotary change in percent (-100 to +100). */
	int8_t stepPercent = 0;
	/** Encoded Switch cluster position: 1..100 Brightness, 101..200 ColorTemp, 201..203 Shutter Swipe. */
	uint8_t encodedPosition = 0;
	/** Signed relative change in Matter LevelControl units (-254 to +254). */
	int16_t stepLevel = 0;
	/** Clamped absolute brightness level (1 to 254) for absolute level bindings. */
	uint8_t targetLevel = 127;
};

/**
 * @brief Stateful rotational dimmer and 3D linear swipe detector for a 3-axis accelerometer.
 *
 * Converts gravity vector rotation in the X-Y plane into live, rate-limited relative
 * updates for brightness/color-temperature, and decomposes 3D linear acceleration
 * relative to the tracked gravity vector to detect orientation-independent Up, Down,
 * and Horizontal swipe gestures for roller shutters.
 */
class RotaryDimmer {
public:
	static constexpr double kPi = 3.14159265358979323846;
	static constexpr double kStandardGravity = 9.81;
	/** Z-axis threshold (m/s^2) above which the button is considered horizontal/flat. */
	static constexpr double kHorizontalZLimit = 7.5;
	/** Minimum squared magnitude (m^2/s^4) in the X-Y plane required for reliable angle calculation. */
	static constexpr double kMinXYMagnitudeSq = 9.0;
	/** Per-sample angular deadband (radians, ~2.0 deg) to reject accelerometer noise at rest. */
	static constexpr double kNoiseDeadbandRad = 0.035;
	/** Minimum accumulated angle (radians, ~8.0 deg) required to emit a live step while turning. */
	static constexpr double kLiveStepAngleRad = 0.14;
	/** Minimum residual angle (radians, ~2.9 deg) flushed after movement settles. */
	static constexpr double kSettleStepAngleRad = 0.05;
	/** Minimum interval (ms) between live Matter transmissions during continuous rotation. */
	static constexpr uint32_t kLiveSendIntervalMs = 150;
	/** Settling time (ms) after rotation stops before flushing any remaining angle delta. */
	static constexpr uint32_t kSettlingTimeMs = 150;
	/** Maps pi radians (180-degree half turn) to full 254 Matter range (~81 units/rad). */
	static constexpr double kRotationToLevelMultiplier = 81.0;
	/** Offset added to Switch cluster position when in ColorTemp mode (101..200). */
	static constexpr uint8_t kColorTempPositionOffset = 100;

	/** Linear acceleration threshold (m/s^2) to trigger a vertical or horizontal swipe. */
	static constexpr double kSwipeAccelThreshold = 4.5;
	/** Linear acceleration threshold (m/s^2) below which gravity low-pass filter updates and swipe re-arms. */
	static constexpr double kLinearRestThreshold = 2.0;
	/** Cooldown window (ms) after a swipe to reject braking/deceleration rebound spikes. */
	static constexpr uint32_t kSwipeCooldownMs = 600;

	/** Switch cluster position emitted on a vertical upward swipe (Shutters Up). */
	static constexpr uint8_t kShutterUpPosition = 201;
	/** Switch cluster position emitted on a vertical downward swipe (Shutters Down). */
	static constexpr uint8_t kShutterDownPosition = 202;
	/** Switch cluster position emitted on a horizontal swipe (Shutters Stop). */
	static constexpr uint8_t kShutterStopPosition = 203;

	/**
	 * @brief Reset the angle baseline when waking the accelerometer for a new session.
	 */
	void ResetOnWake();

	/**
	 * @brief Set the active rotary control mode (Brightness or ColorTemp).
	 */
	void SetControlMode(RotaryControlMode mode) { mControlMode = mode; }

	/**
	 * @brief Get the active rotary control mode (Brightness or ColorTemp).
	 */
	RotaryControlMode GetControlMode() const { return mControlMode; }

	/**
	 * @brief Process a 3-axis accelerometer reading (in m/s^2) at timestamp nowMs.
	 *
	 * @param x X-axis acceleration in m/s^2.
	 * @param y Y-axis acceleration in m/s^2.
	 * @param z Z-axis acceleration in m/s^2.
	 * @param nowMs Monotonic system uptime in milliseconds.
	 * @return RotaryUpdate describing any rotary step or linear swipe gesture.
	 */
	RotaryUpdate ProcessSample(double x, double y, double z, uint32_t nowMs);

	/**
	 * @brief Return the current tracked absolute brightness level (1..254).
	 */
	uint8_t GetTargetLevel() const { return static_cast<uint8_t>(mAccumulatedBrightness); }

private:
	/**
	 * @brief Normalize an angle difference in radians into (-pi, pi].
	 */
	static double NormalizeAngle(double angleRad);

	/**
	 * @brief Populate rotary step fields in outUpdate from mPendingAngleDelta and clear pending delta.
	 */
	void FlushPendingDelta(uint32_t nowMs, RotaryUpdate &outUpdate);

	RotaryControlMode mControlMode = RotaryControlMode::Brightness;
	double mLastAngle = 0.0;
	double mPendingAngleDelta = 0.0;
	double mAccumulatedBrightness = 127.0;
	double mGravityX = kStandardGravity;
	double mGravityY = 0.0;
	double mGravityZ = 0.0;
	uint32_t mLastMovementTimeMs = 0;
	uint32_t mLastSendTimeMs = 0;
	uint32_t mSwipeCooldownUntilMs = 0;
	bool mFirstSampleAfterWake = true;
	bool mSwipeArmed = true;
};
```
